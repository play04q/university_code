#include <REGX51.H>
const tab1[]={0xf0,0x0f,0xf0,0x0f,0xf0,0x0f,
							0xaa,0x55,0xaa,0x55,0xaa,0x55,0xff,};
const tab2[]={0xfe,0xfd,0xfb,0xf7,0xef,0xdf,0xbf,0x7f,
							0xbf,0xdf,0xef,0xf7,0xfb,0xfd,0xfe,0xff,
							0xfe,0xfd,0xfb,0xf7,0xef,0xdf,0xbf,0x7f,
							0xbf,0xdf,0xef,0xf7,0xfb,0xfd,0xfe,0xff,};
char a;
void delay()
{
	int i,j;
	for(i=0;i<256;i++)
	for(j=0;j<256;j++)
	{;}
}
void int0() interrupt 0
{
	a=a+1;
	if(a==1)
	{
		char i;
		for(i=0;i<13;i++)
		{
			P0=tab1[i];
			delay();
		}
	}
	if(a==2)
	{
		char i;
		for(i=0;i<32;i++)
		{
			P0=tab2[i];
			delay();
		}
		a=0;
	}
}
void int1() interrupt 2
{
	P1_0=0;
	delay();
	P1_0=1;
}
void main()
{
	IE=0x85;
	IP=0x04;
	TCON=0x00;
	a=0;
	while(1)
	{
		char x;
		for(x=0;x<23;x++)
		{
			P0=~P0;
			delay();
		}
	}
}